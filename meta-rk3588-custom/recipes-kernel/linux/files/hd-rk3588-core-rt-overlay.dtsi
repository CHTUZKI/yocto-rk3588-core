/*
 * RT overlay: keep GPU/NPU powered down and out of the device tree.
 * Appended to hd-rk3588-core.dts when RK3588_KERNEL_RT=1.
 */
&rknpu {
	status = "disabled";
};

&rknpu_mmu {
	status = "disabled";
};

&gpu {
	status = "disabled";
};

&vdd_gpu_s0 {
	/delete-property/ regulator-always-on;
	/delete-property/ regulator-boot-on;
};
